## u-boot-2017.11/arch/arm/mach-stm32/stm32f7/Kconfig
```kconfig
if STM32F7

config TARGET_STM32F767_APOLLO
	bool "STM32F767 Apollo board"

source "board/st/stm32f767-apollo/Kconfig"

endif
```

## u-boot-2017.11/board/st/stm32f767-apollo/Kconfig
```kconfig
if TARGET_STM32F767_APOLLO

config SYS_BOARD
	string
	default "stm32f767-apollo"

config SYS_VENDOR
	string
	default "st"

config SYS_SOC
	string
	default "stm32f7"

config SYS_CONFIG_NAME
	string
	default "stm32f767-apollo"

endif
```
